## package/docopt-cpp/Config.in
```kconfig
config BR2_PACKAGE_DOCOPT_CPP
	bool "docopt-cpp"
	depends on BR2_INSTALL_LIBSTDCPP
	help
	  C++11 port of docopt, a CLI option parser

	  https://github.com/docopt/docopt.cpp
```

## package/libnetconf2/Config.in
```kconfig
config BR2_PACKAGE_LIBNETCONF2
	bool "libnetconf2"
	select BR2_PACKAGE_LIBYANG
	select BR2_PACKAGE_LIBSSH
	select BR2_PACKAGE_LIBSSH_SERVER
	select BR2_PACKAGE_OPENSSL
	help
	  A NETCONF library in C intended for building NETCONF clients
	  and servers. NETCONF is the NETwork CONFiguration protocol
	  introduced by IETF.

	  https://github.com/CESNET/libnetconf2
```

## package/libredblack/Config.in
```kconfig
config BR2_PACKAGE_LIBREDBLACK
	bool "libredblack"
	help
	  RedBlack Balanced Tree Searching and Sorting Library

	  http://libredblack.sourceforge.net/
```

## package/libyang/Config.in
```kconfig
config BR2_PACKAGE_LIBYANG
	bool "libyang"
	select BR2_PACKAGE_PCRE
	select BR2_PACKAGE_PCRE_UCP
	help
	  LibYANG processes YIN and YANG files. These files are used in
	  NETCONF, an Internet protocol for remote control of network devices.

	  https://github.com/CESNET/libyang
```

## package/netopeer2-server/Config.in
```kconfig
config BR2_PACKAGE_NETOPEER2_SERVER
	bool "netopeer2-server"
	select BR2_PACKAGE_LIBYANG
	select BR2_PACKAGE_LIBNETCONF2
	select BR2_PACKAGE_SYSREPO
	help
	  A NETCONF server with a modular datastore allowing
	  interconnection and control of various applications.

	  https://github.com/CESNET/Netopeer2
```

## package/spdlog/Config.in
```kconfig
config BR2_PACKAGE_SPDLOG
	bool "spdlog"
	depends on BR2_INSTALL_LIBSTDCPP
	help
	  Very fast, header only, C++ logging library. Needs a C++14 compiler.

	  https://github.com/gabime/spdlog
```

## package/sysrepo/Config.in
```kconfig
config BR2_PACKAGE_SYSREPO
	bool "sysrepo"
	select BR2_PACKAGE_LIBEV
	select BR2_PACKAGE_LIBREDBLACK
	select BR2_PACKAGE_LIBYANG
	select BR2_PACKAGE_PROTOBUF_C
	depends on !BR2_STATIC_LIBS
	depends on BR2_TOOLCHAIN_HAS_THREADS
	depends on BR2_INSTALL_LIBSTDCPP

	help
	  sysrepo is a YANG-based configuration and operational state data
	  store. It is used by Netopeer2, a NETCONF server. The NETCONF
	  Internet protocol is used for remote management of network devices.

	  http://www.sysrepo.org/

comment "needs a toolchain w/ threads, C++, dynamic library"
	depends on BR2_STATIC_LIBS || !BR2_TOOLCHAIN_HAS_THREADS \
		|| !BR2_INSTALL_LIBSTDCPP
```
